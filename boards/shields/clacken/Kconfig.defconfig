## boards/shields/clacken/Kconfig.defconfig
```kconfig
if SHIELD_CLACKEN_LEFT

config ZMK_KEYBOARD_NAME
    default "Brian's Clacken"

config ZMK_SPLIT_ROLE_CENTRAL
    default y

config ZMK_STUDIO
    default y

config CONFIG_ZMK_BLE_EXPERIMENTAL_CONN
    def_bool n

config CONFIG_ZMK_HID_REPORT_TYPE_NKRO
    def_bool n

endif


if SHIELD_CLACKEN_LEFT || SHIELD_CLACKEN_RIGHT

config ZMK_SPLIT
    default y

endif
```
